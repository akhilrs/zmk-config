## config/corneish_zen_v2_left_defconfig
```kconfig
CONFIG_BOARD_CORNEISH_ZEN_V2_LEFT=y

# Custom status screens
CONFIG_CUSTOM_WIDGET_OUTPUT_STATUS=y
CONFIG_ZMK_WIDGET_OUTPUT_STATUS=n
CONFIG_CUSTOM_WIDGET_LAYER_STATUS=y
CONFIG_ZMK_WIDGET_LAYER_STATUS=n

CONFIG_ZMK_USB=n
```

## config/corneish_zen_v2_right_defconfig
```kconfig
CONFIG_BOARD_CORNEISH_ZEN_V2_RIGHT=y

# Custom status screens
CONFIG_CUSTOM_WIDGET_PERIPHERAL_STATUS=y
CONFIG_ZMK_WIDGET_PERIPHERAL_STATUS=n
```
